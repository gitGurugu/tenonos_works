## tenon/arch/x86/x86_64/defconfig
```kconfig
CONFIG_ARCH_X86_64=y
CONFIG_PLAT_KVM=y
CONFIG_UK_FULLVERSION="0.1.0"
CONFIG_HAVE_BOOTENTRY=y
CONFIG_HAVE_SCHED=y
CONFIG_HAVE_MEMALLOC=y
CONFIG_HAVE_LIBC=y
CONFIG_LIBUKALLOC=y
CONFIG_LIBUKSCHED=y
CONFIG_LIBUKSCHEDCOOP=y
CONFIG_LIBPOSIX_PROCESS=y
CONFIG_LIBPOSIX_USER=y
CONFIG_LIBUKDEBUG=y
CONFIG_LIBUKDEBUG_PRINTK=y
CONFIG_LIBUKDEBUG_PRINTK_INFO=y
CONFIG_LIBUKLIBPARAM=y
CONFIG_LIBUKLOCK=y
CONFIG_LIBUKMPI=y
CONFIG_LIBUKSGLIST=y
CONFIG_LIBUKSWRAND=y
CONFIG_LIBUKTIME=y
CONFIG_LIBUKTIMECONV=y
CONFIG_LIBVFSCORE=y
```

## tenon/support/kconfig/c_tests/extend_config/def_test_files/defconfig
```kconfig
CONFIG_TEST_BOOL_Y=y
# CONFIG_TEST_BOOL_N is not set
CONFIG_TEST_STRING="This is a test string."
CONFIG_TEST_INT=8
CONFIG_TEST_HEX=0x10
CONFIG_EXTENDTEST_BOOL_Y=y
# CONFIG_EXTENDTEST_BOOL_N is not set
CONFIG_EXTENDTEST_STRING="This is a test string."
CONFIG_EXTENDTEST_INT=8
CONFIG_EXTENDTEST_HEX=0x1000
```

## tenon/support/kconfig/tests/extend_config/Kconfig
```kconfig
# SPDX-License-Identifier: GPL-2.0

menu "Command selection"
config EXTEND_BUILDIN_COMMAND_KILL
	bool "kill"
	default y
	help
	  This is a symbol,default y.
	  Provide to testconfig as a test case.
	  Verify that the generated extend file meets the requirements
	  Is not a true config.uk
	  configuration item

config EXTEND_BUILDIN_COMMAND_PS
	bool "ps"
	default n
	help
	  This is a symbol,default n.
	  Provide to testconfig as a test case.
	  Verify that the generated extend file meets the requirements
	  Is not a true config.uk
	  configuration item
endmenu
```
